## configs/am335x_sbc8600b_defconfig
```kconfig
CONFIG_SPL=y
CONFIG_SYS_EXTRA_OPTIONS="SBC8600B,NAND,CONS_INDEX=4"
+S:CONFIG_ARM=y
+S:CONFIG_TARGET_AM335X_EVM=y
CONFIG_OF_CONTROL=y
CONFIG_DEFAULT_DEVICE_TREE="am335x-boneblack"
CONFIG_FIT=y
CONFIG_FIT_VERBOSE=y
CONFIG_FIT_SIGNATURE=y
CONFIG_DM=y
```
